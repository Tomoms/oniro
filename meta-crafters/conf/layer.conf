## meta-crafters/conf/layer.conf
```bitbake
# We have a conf and classes directory, add to BBPATH
BBPATH .= ":${LAYERDIR}"

# We have recipes-* directories, add to BBFILES
BBFILES += "${LAYERDIR}/recipes-*/*/*.bb \
            ${LAYERDIR}/recipes-*/*/*.bbappend"

BBFILE_COLLECTIONS += "meta-crafters"
BBFILE_PATTERN_meta-crafters = "^${LAYERDIR}/"
BBFILE_PRIORITY_meta-crafters = "6"

LAYERDEPENDS_meta-crafters = "core"
LAYERSERIES_COMPAT_meta-crafters = "kirkstone"
```
